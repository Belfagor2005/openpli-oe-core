## meta-gigablue/conf/machine/gbtrio4k.conf
```bitbake
#@TYPE: Machine
#@NAME: Gigablue Trio 4K(pro)
#@DESCRIPTION: Machine configuration for the Gigablue Trio 4K(pro)

SOC_FAMILY = "hisi3798mv200"
CHIPSET = "Hi3798Mv200"
HICHIPSET = "3798mv200"

BRAND_OEM = "gigablue"
MACHINE_BRAND = "GigaBlue"
MACHINE_NAME = "UHD TRIO 4K"

FRIENDLY_FAMILY = "gbmv200"
STB_PLATFORM = "gbmv200"
MACHINE_MODEL = "gbmv200"

KERNEL_FILE = "uImage"
ROOTFS_FILE = "rootfs.tar.bz2"
MTD_BLACK  = "mmcblk0"
MTD_KERNEL = "mmcblk0p12"
MTD_ROOTFS = "mmcblk0p16"

MACHINE_FEATURES += "hdmicec 7segment textlcd hisil mali transcoding emmc skins1080 no-subssupport blindscan-dvbs blindscan dvb-c gfwol fastboot mountboot HDMI HDMISTANDBY AV_JACK inibt hifblayer"
OPENPLI_FEATURES += " qtplugins kodi"
DISTRO_FEATURES:remove = "x11 wayland directfb"

EXTRA_OECONF:append:pn-enigma2 = "--with-lcddev=/dev/null --with-alphablendingacceleration=always --with-blitaccelerationthreshold=250  --with-fillaccelerationthreshold=190000"

require conf/machine/include/gigablue-gbtrio4k.inc
```

## meta-gigablue/conf/machine/include/gigablue-gb7252.inc
```bitbake
require conf/machine/include/gigablue-arm.inc

MACHINE_KERNEL_PR = "${@bb.utils.contains('MACHINE', 'gbquad4kpro', 'r9' , 'r7', d)}"

MACHINE_EXTRA_RRECOMMENDS = " \
    gst-plugin-dvbmediasink \
    ntfs-3g \
"

PREFERRED_VERSION_linux-gigablue = "4.1.20"
PREFERRED_PROVIDER_virtual/kernel = "linux-gigablue"
PREFERRED_PROVIDER_virtual/kodi = "stb-kodi-gb7252"

PACKAGECONFIG_GL:pn-qtbase = " gles2 eglfs linuxfb"

# xbmc/kodi support
DEPENDS:append:pn-kodi = " gigablue-kodi-${MACHINE}"

IMGDEPLOYDIR ?= "${DEPLOY_DIR_IMAGE}"

IMAGE_CMD:tar:prepend = "\
    rm -Rf ${IMAGE_ROOTFS}/tmp/*; \
    mkdir -p ${IMGDEPLOYDIR}/${IMAGEDIR}; \
    cp ${DEPLOY_DIR_IMAGE}/${MACHINE}_boot.bin ${IMGDEPLOYDIR}/${IMAGEDIR}/boot.bin; \
    cp ${DEPLOY_DIR_IMAGE}/${MACHINE}_gpt.bin ${IMGDEPLOYDIR}/${IMAGEDIR}/gpt.bin; \
    cp ${DEPLOY_DIR_IMAGE}/${MACHINE}_rescue.bin ${IMGDEPLOYDIR}/${IMAGEDIR}/rescue.bin; \
    cp ${DEPLOY_DIR_IMAGE}/${MACHINE}_bolt_${SRCDATE_BOLT}.bin ${IMGDEPLOYDIR}/${IMAGEDIR}/bolt_${SRCDATE_BOLT}.bin; \
    cp ${DEPLOY_DIR_IMAGE}/zImage ${IMGDEPLOYDIR}/${IMAGEDIR}/kernel.bin; \
    echo ${DISTRO_NAME}-${DISTRO_VERSION}.${BUILD_VERSION} > ${IMGDEPLOYDIR}/${IMAGEDIR}/imageversion; \
    cd ${IMAGE_ROOTFS}; \
    tar -cvf ${IMGDEPLOYDIR}/rootfs.tar -C ${IMAGE_ROOTFS} .; \
    mv ${IMGDEPLOYDIR}/rootfs.tar ${IMGDEPLOYDIR}/${IMAGEDIR}/rootfs.tar; \
    bzip2 ${IMGDEPLOYDIR}/${IMAGEDIR}/rootfs.tar; \
    cd ${IMGDEPLOYDIR}; \
    zip ${IMAGE_NAME}_usb.zip ${IMAGEDIR}/*; \
    rm -Rf gigablue; \
"

MACHINE_ESSENTIAL_EXTRA_RDEPENDS += " \
    gigablue-platform-util-${MACHINE_DRIVER} \
    gigablue-ddbootup \
    gigablue-swapcreate \
"

MACHINE_ESSENTIAL_EXTRA_RRECOMMENDS += " \
    gb-v3ddriver-${MACHINE_DRIVER} \
    gb-qteglfs-platform \
    ${@bb.utils.contains('MACHINE', 'gbquad4kpro', 'gigablue-firmware-aic8800d80 gigablue-aic8800-driver gigablue-bluetooth-keymaps' , '', d)} \
    kernel-module-88xxau \
    kernel-module-88x2bu \
    "

EXTRA_IMAGEDEPENDS = "\
    gigablue-initrd-cfe-${MACHINE} \
    "

OPTIONAL_BSP_PACKAGES += "\
    gigablue-bootloader-${MACHINE} \
    "

OPTIONAL_BSP_ENIGMA2_PACKAGES = "\
    enigma2-plugin-extensions-hbbtv-gb \
    enigma2-plugin-extensions-chromium \
    "
```

## meta-octagon/conf/machine/sf8008m.conf
```bitbake
#@TYPE: Machine
#@NAME: sf8008m
#@DESCRIPTION: Machine configuration for the sf8008m

SOC_FAMILY = "hisi3798mv200"
CHIPSET = "Hi3798Mv200"
HICHIPSET = "3798mv200"

BRAND_OEM = "octagon"
MACHINE_BRAND = "Octagon"
MACHINE_NAME = "SF8008 MINI 4K"

MTD_ROOTFS = "mmcblk0p16"
MTD_KERNEL = "mmcblk0p12"
KERNEL_FILE = "kernel.bin"
ROOTFS_FILE = "rootfs.tar.bz2"
MTD_BLACK  = "mmcblk0"

MACHINE_FEATURES += " textlcd 7segment blindscan-dvbs hisil mali transcoding emmc skins1080 no-subssupport dvb-c fastboot HDMI AV_JACK hifblayer"
OPENPLI_FEATURES += " qtplugins kodi openhbbtvbrowser"
DISTRO_FEATURES:remove = "x11 wayland directfb"

EXTRA_OECONF:append:pn-enigma2 = "--with-lcddev=/dev/null --with-alphablendingacceleration=always --with-blitaccelerationthreshold=250  --with-fillaccelerationthreshold=190000"

require conf/machine/include/octagon-hisi.inc
```

## meta-octagon/conf/machine/sx88v2.conf
```bitbake
#@TYPE: Machine
#@NAME: sx88v2
#@DESCRIPTION: Machine configuration for the sx88v2

SOC_FAMILY = "hisi3798mv300"
CHIPSET = "Hi3798Mv300"
HICHIPSET = "3798mv300"

BRAND_OEM = "octagon"
MACHINE_BRAND = "Octagon"
MACHINE_NAME = "SX88V2 4K DUAL OS"

MTD_ROOTFS = "mmcblk0p16"
MTD_KERNEL = "mmcblk0p12"
KERNEL_FILE = "kernel.bin"
ROOTFS_FILE = "rootfs.tar.bz2"

MACHINE_FEATURES += " textlcd 7segment blindscan-dvbs hisil mali transcoding emmc skins1080 no-subssupport fastboot HDMI HDMISTANDBY AV_JACK hifblayer"
OPENPLI_FEATURES += " qtplugins kodi openhbbtvbrowser"
DISTRO_FEATURES:remove = "x11 wayland directfb"

EXTRA_OECONF:append:pn-enigma2 = "--with-lcddev=/dev/null --with-alphablendingacceleration=always --with-blitaccelerationthreshold=250  --with-fillaccelerationthreshold=190000"

require conf/machine/include/octagon-hisi-3798mv300.inc

MACHINE_ESSENTIAL_EXTRA_RDEPENDS += "\
    firmware-uwe5621 \
    "
```

## meta-uclan/conf/machine/ustym4kpro.conf
```bitbake
#@TYPE: Machine
#@NAME: ustym4kpro
#@DESCRIPTION: Machine configuration for the ustym4kpro

SOC_FAMILY = "hisi3798mv200"
CHIPSET = "Hi3798Mv200"
HICHIPSET = "3798mv200"

BRAND_OEM = "uclan"
MACHINE_BRAND = "Uclan"
MACHINE_NAME = "Ustym 4K PRO"

MTD_ROOTFS = "mmcblk0p16"
MTD_KERNEL = "mmcblk0p12"
KERNEL_FILE = "kernel.bin"
ROOTFS_FILE = "rootfs.tar.bz2"
MTD_BLACK  = "mmcblk0"

MACHINE_FEATURES += " dvb-c textlcd 7segment blindscan-dvbs hisil mali transcoding emmc skins1080 no-subssupport fastboot HDMI AV_JACK HDMISTANDBY hifblayer"
OPENPLI_FEATURES += " qtplugins kodi openhbbtvbrowser"
DISTRO_FEATURES:remove = "x11 wayland"

EXTRA_OECONF:append:pn-enigma2 = "--with-lcddev=/dev/null --with-alphablendingacceleration=always --with-blitaccelerationthreshold=250  --with-fillaccelerationthreshold=190000"

require conf/machine/include/uclan-hisi.inc

MACHINE_ESSENTIAL_EXTRA_RDEPENDS += "\
    kernel-module-88x2cu \
    "
```

## meta-uclan/conf/machine/ustym4ks2ottx.conf
```bitbake
#@TYPE: Machine
#@NAME: ustym4ks2ottx
#@DESCRIPTION: Machine configuration for the ustym4ks2ottx

SOC_FAMILY = "hisi3798mv300"
CHIPSET = "Hi3798Mv300"
HICHIPSET = "3798mv300"

BRAND_OEM = "uclan"
MACHINE_BRAND = "Uclan"
MACHINE_NAME = "Ustym 4K S2 OTT X"

MTD_ROOTFS = "mmcblk0p16"
MTD_KERNEL = "mmcblk0p12"
KERNEL_FILE = "kernel.bin"
ROOTFS_FILE = "rootfs.tar.bz2"
MTD_BLACK  = "mmcblk0"

MACHINE_FEATURES += " textlcd 7segment blindscan-dvbs hisil mali transcoding emmc skins1080 no-subssupport fastboot HDMI AV_JACK HDMISTANDBY hifblayer"
OPENPLI_FEATURES += " qtplugins kodi openhbbtvbrowser"
DISTRO_FEATURES:remove = "x11 wayland"

EXTRA_OECONF:append:pn-enigma2 = "--with-lcddev=/dev/null --with-alphablendingacceleration=always --with-blitaccelerationthreshold=250  --with-fillaccelerationthreshold=190000"

require conf/machine/include/uclan-hisi-3798mv300.inc
```

## meta-vuplus/conf/layer.conf
```bitbake
# We have a conf and classes directory, append to BBPATH
BBPATH .= ":${LAYERDIR}"

BBFILES += "${LAYERDIR}/recipes-*/*.bb ${LAYERDIR}/recipes-*/*/*.bb \
            ${LAYERDIR}/recipes-*/*.bbappend ${LAYERDIR}/recipes-*/*/*.bbappend"

BSP-BASE-VUPLUS := '${@os.path.normpath("${LAYERDIR}/")}'
```

## meta-xtrend/conf/machine/et5x00.conf
```bitbake
#@TYPE: Machine
#@NAME: Xtrend et5x00
#@DESCRIPTION: Machine configuration for the Xtrend et5x00

SOC_FAMILY = "bcm7413"
CHIPSET = "bcm7413"

BRAND_OEM = "xtrend"
MACHINE_BRAND = "Xtrend"
MACHINE_NAME = "ET5X00"

KERNEL_FILE = "kernel.bin"
ROOTFS_FILE = "rootfs.bin"
MTD_KERNEL = "mtd1"
MTD_ROOTFS = "mtd2"

MACHINE_FEATURES += " micom nocld videoenhancement smallflash HDMI YUV NO_SCART_SWITCH"
DISTRO_FEATURES:remove = "x11 wayland directfb"

MKUBIFS_ARGS = "-m 2048 -e 126976 -c 4096"
UBINIZE_ARGS = "-m 2048 -p 128KiB"


RCTYPE = "7"

PREFERRED_PROVIDER_virtual/blindscan-dvbs = "et-blindscan-dvbs-utils"
PREFERRED_VERSION_linux-et = "3.8.7"
require conf/machine/include/et-mipsel.inc
```
